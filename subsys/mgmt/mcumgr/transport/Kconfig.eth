## subsys/mgmt/mcumgr/transport/Kconfig.eth
```kconfig
# Copyright (c) 2026 Aleksandr Senin
# SPDX-License-Identifier: Apache-2.0

# The Kconfig file is dedicated to the raw Ethernet transport of the MCUmgr
# subsystem and provides Kconfig options to control aspects of the transport.
#
# Options defined in this file should be prefixed:
#  MCUMGR_TRANSPORT_ETH_

menuconfig MCUMGR_TRANSPORT_ETH
	bool "Raw Ethernet MCUmgr SMP transport"
	depends on NET_L2_ETHERNET
	help
	  Enables handling of SMP commands received in raw Ethernet frames.
	  Each SMP frame is carried in the payload of a single Ethernet frame
	  with the configured EtherType, without any IP stack involvement.
	  Requests are accepted on any Ethernet interface and replies are sent
	  from the interface the request was received on, back to the MAC
	  address of the sender.

if MCUMGR_TRANSPORT_ETH

config MCUMGR_TRANSPORT_ETH_ETHERTYPE
	hex "EtherType used for SMP frames"
	default 0x88B5
	help
	  EtherType of the Ethernet frames carrying SMP data.
	  The default value 0x88B5 is the IEEE 802 "Local Experimental
	  EtherType 1".

config MCUMGR_TRANSPORT_ETH_MTU
	int "Ethernet SMP MTU"
	range 1 MCUMGR_TRANSPORT_NETBUF_SIZE
	default MCUMGR_TRANSPORT_NETBUF_SIZE if MCUMGR_TRANSPORT_NETBUF_SIZE < 1500
	default 1500
	help
	  Maximum size of SMP frames sent and received over raw Ethernet, in
	  bytes. This should not exceed the MTU of the Ethernet interfaces
	  used, as SMP frames are carried in a single Ethernet frame.
	  This value must satisfy the following relation:
	  MCUMGR_TRANSPORT_ETH_MTU <= MCUMGR_TRANSPORT_NETBUF_SIZE

config MCUMGR_TRANSPORT_ETH_AUTOMATIC_INIT
	bool "Ethernet SMP autostart"
	default y
	help
	  Enable starting the Ethernet SMP transport at boot time without
	  needing any code in the application to do this, otherwise will need
	  the user application to manually start and stop the transport using
	  `smp_eth_open` and `smp_eth_close`.

endif # MCUMGR_TRANSPORT_ETH
```
